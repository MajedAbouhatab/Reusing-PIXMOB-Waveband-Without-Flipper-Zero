#include <RadioLib.h>

unsigned long Timestamp;
SX1276 radio = new Module(RADIO_NSS_PORT, RADIO_DIO_0_PORT, RADIO_RESET_PORT, RADIO_DIO_1_PORT);
int ColorIndex = 0, BitDuration = 500;
#define ValidValuesCount 4
#define BytesCount 12

void MicrosDelay(unsigned long m)
{
  unsigned long n = micros();
  while (micros() - n < m)
    yield;
}

std::array<byte, BytesCount> ByteArray;
std::array<std::array<int, BytesCount>, ValidValuesCount> ColorArrayArray{{
    {0xaa, 0xaa, 0x65, 0x21, 0x24, 0x6d, 0x61, 0x23, 0x11, 0x61, 0x2b, 0x40}, // gold_fade_in
    {0xaa, 0xaa, 0x5b, 0x61, 0x24, 0x6d, 0x61, 0x12, 0x51, 0x61, 0x22, 0x80}, // gold_fast_fade
    // {0xaa,0xaa,0x55,0xa1,0x21,0x21,0x21,0x18,0x8d,0xa1,0xa,0x40}, //nothing
    // {0xaa, 0xaa, 0x61, 0x21, 0xc, 0xa1, 0x2d, 0x62, 0x62, 0x61, 0xd, 0x80}, // rand_blue_fade
    // {0xaa,0xaa,0x50,0xa1,0x24,0x6d,0x61,0x19,0x1a,0xa1,0x12,0x40}, //rand_gold_blink
    // {0xaa,0xaa,0x52,0xa1,0x24,0x6d,0x61,0x22,0x6a,0x61,0xd}, //rand_gold_fade
    // {0xaa,0xaa,0x55,0xa1,0x24,0x6d,0x61,0xa,0x59,0x61,0x18,0x40}, //rand_gold_fastfade
    // {0xaa,0xaa,0x69,0x21,0x21,0x2d,0x61,0x22,0x62,0x61,0x19,0x40}, //rand_red_fade
    // {0xaa,0xaa,0x5b,0x61,0x21,0x2d,0x61,0x19,0x1a,0xa1,0xa,0x40}, //rand_red_fastblink
    // {0xaa,0xaa,0x53,0x21,0x21,0x2d,0x61,0xa,0x59,0x61,0x11,0x40}, //rand_red_fastfade
    // {0xaa,0xaa,0x4d,0xa1,0x2d,0x61,0x2c,0x6d,0x93,0x61,0x24,0x40}, //rand_turq_blink
    // {0xaa,0xaa,0x52,0xa1,0x2d,0x6d,0x6d,0x59,0x1a,0xa1,0x22,0x40}, //rand_white_blink
    // {0xaa,0xaa,0x59,0x61,0x2d,0x6d,0x6d,0x62,0x62,0x61,0x2b,0x40}, //rand_white_fade
    // {0xaa,0xaa,0x66,0xa1,0x2d,0x6d,0x6d,0x4a,0x59,0x61,0x2a,0x40}, //rand_white_fastfade
    {0xaa, 0xaa, 0x56, 0xa1, 0x2d, 0x6d, 0x6d, 0x52, 0x51, 0x61, 0xb},        // white_fastfade
    {0xaa, 0xaa, 0x69, 0xa1, 0x21, 0x2d, 0x61, 0x23, 0x11, 0x61, 0x28, 0x40}, // wine_fade_in
}};

void ByteArraySend(void)
{
  for (int j = 0; j < sizeof(ByteArray); j++)
    for (int i = 0; i < 8; i++)
    {
      digitalWrite(RADIO_DIO_2_PORT, (128U & ByteArray[j]) / 128U);
      MicrosDelay(BitDuration);
      ByteArray[j] <<= 1;
    }
  LL_GPIO_ResetOutputPin(get_GPIO_Port(PortB), LL_GPIO_PIN_0);
  for (int k = 0; k < 8; k++)
    MicrosDelay(BitDuration);
}

void setup()
{
  pinMode(RADIO_DIO_2_PORT, OUTPUT);
  SPI.setMOSI(RADIO_MOSI_PORT);
  SPI.setMISO(RADIO_MISO_PORT);
  SPI.setSCLK(RADIO_SCLK_PORT);
  radio.beginFSK();
  radio.setFrequency(915.0F);
  radio.setOOK(true);
  radio.transmitDirect();
}

void loop()
{
  ByteArray = {0xaa, 0xaa, 0x55, 0xa1, 0x21, 0x21, 0x21, 0x18, 0x8d, 0xa1, 0x0a, 0x40};
  ByteArraySend();
  if (millis() - Timestamp > 2000)
  {
    Timestamp = millis();
    for (int i = 0; i < BytesCount; i++)
      ByteArray[i] = ColorArrayArray[ColorIndex][i];
    ByteArraySend();
    ColorIndex = ColorIndex++ == ValidValuesCount - 1 ? 0 : ColorIndex;
  }
}
